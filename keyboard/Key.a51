		ORG		0000H
		RS 		EQU P3.7
		RW		EQU	P3.6
		E		EQU P3.5
		LJMP	MAIN
		ORG		0100H
MAIN:	MOV		P1,#00000001B
		ACALL	ENABLE
		MOV		P1,#00111000B
		ACALL	ENABLE
		MOV		P1,#00001111B
		ACALL	ENABLE
		MOV		P1,#00000110B
		ACALL	ENABLE
		MOV		P1,#0C0H
		ACALL	ENABLE
LOOP:	ACALL 	DELAYL
		SETB	E
		ACALL	KEYSCAN
		MOV		P0,31H
		SJMP	LOOP
KEYSCAN:MOV		P2,#0FH
		MOV		A,P2
		ANL		A,#0FH
		MOV		R3,A
		MOV		P2,#0F0H
		MOV		A,P2
		ANL		A,#0F0H
		ORL		A,R3
		CJNE	A,#0FFH,KEYPRO
		RET
KEYPRO:	MOV		R3,A
		MOV		DPTR,#KEYVALUE
		MOV		R4,#0FFH
KEY1:	INC		R4
		MOV		A,R4
		MOVC	A,@A+DPTR
		MOV		30H,R3
		CJNE	A,30H,KEY1
		MOV		A,R4
		MOV		DPTR,#LEDDB
		MOVC	A,@A+DPTR
		MOV		31H,A
		MOV		A,R4
		MOV		DPTR,#LCDDB
		MOVC	A,@A+DPTR
		MOV		R4,A
		MOV		P1,R4
		SETB	RS
		CLR		RW
		CLR		E
		ACALL	DELAY
		CLR		E
		AJMP	LOOP
ENABLE:	CLR		RS
		CLR		RW
		CLR		E
		ACALL	DELAY
		SETB	E
		RET
DELAY:	MOV		P1,#0FFH
		CLR		RS
		SETB	RW
		CLR		E
		NOP
		SETB	E
		JB		P1.7,DELAY
		RET
DELAYL:	MOV		R5,#40H
NEXT1:	MOV		R6,#46H
NEXT2:	MOV		R7,#46H
		DJNZ	R7,$
		DJNZ	R6,NEXT2
		DJNZ	R5,NEXT1
		RET
			
KEYVALUE:DB	77H,7BH,7DH,7EH,0B7H,0BBH,0BDH,0BEH,0D7H,0DBH,0DDH,0DEH,0E7H,0EBH,0EDH,0EEH
LEDDB:	 DB	0C0H,0F9H,0A4H,0B0H,99H,92H,82H,0F8H,80H,90H,88H,83H,0C6H,0A1H,86H,8EH
LCDDB:	 DB	30H,31H,32H,33H,34H,35H,36H,37H,38H,39H,41H,42H,43H,44H,45H,46H
		END