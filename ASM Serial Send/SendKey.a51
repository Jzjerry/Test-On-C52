		ORG		0000H
		RS 		EQU P3.7
		RW		EQU	P3.6
		E		EQU P3.5
		LJMP	MAIN
		ORG		0100H
MAIN:	MOV		P1,#00000001B
		ACALL	ENABLE
		MOV		P1,#00111000B
		ACALL	ENABLE
		MOV		P1,#00001111B
		ACALL	ENABLE
		MOV		P1,#00000110B
		ACALL	ENABLE
		
ASTART:	CLR		EA
		MOV		TMOD,#20H
		MOV		TH1,#0F4H
		MOV		TL1,#0F4H
		MOV		PCON,#00H
		SETB	TR1
		MOV		SCON,#50H
		
ALOOP1:	MOV		SBUF,#0E1H		;Preparation Start
		JNB		TI,$
		CLR		TI
		
		JNB		RI,$
		CLR		RI
		MOV		A,SBUF
		XRL		A,#0E2H
		JNZ		ALOOP1			;Preparation End		
		
LOOP:	ACALL	DELAYL
		SETB	E
		ACALL	KEYSCAN
		SJMP	LOOP
		
KEYSCAN:MOV		P2,#0FH
		MOV		A,P2
		ANL		A,#0FH
		MOV		R3,A
		MOV		P2,#0F0H
		MOV		A,P2
		ANL		A,#0F0H
		ORL		A,R3
		CJNE	A,#0FFH,KEYPRO
		RET
		
KEYPRO:	MOV		R3,A
		MOV		DPTR,#KEYVALUE
		MOV		R4,#0FFH
		
KEY1:	INC		R4
		MOV		A,R4
		MOVC	A,@A+DPTR
		MOV		30H,R3
		CJNE	A,30H,KEY1

		MOV		A,R4
		MOV		DPTR,#LCDDB
		MOVC	A,@A+DPTR
		MOV		R4,A
		
		MOV		A,#0FAH
		XRL		A,R4
		JZ		ENTER
		
		MOV		A,#0FBH
		XRL		A,R4
		JZ		CLEAR
		
		
		MOV		P1,R4
		
		SETB	RS
		CLR		RW
		CLR		E
		ACALL	DELAY
		CLR		E
		
SENDTO:	ACALL	SEND
		
		AJMP	LOOP

CLEAR:	MOV		P1,#00010000B
		ACALL	ENABLE
		SJMP	SENDTO

ENTER:	MOV		P1,#00000110B
		ACALL	ENABLE
		MOV		P1,#0C0H
		ACALL	ENABLE
		SJMP	SENDTO

ENABLE:	CLR		RS
		CLR		RW
		CLR		E
		ACALL	DELAY
		SETB	E
		RET
		
DELAY:	MOV		P1,#0FFH
		CLR		RS
		SETB	RW
		CLR		E
		NOP
		SETB	E
		JB		P1.7,DELAY
		RET

SEND:	MOV		R6,#00H
		MOV		SBUF,R4			;Communicaton Start
		MOV		A,R6
		ADD		A,R4
		MOV		R6,A
		
		JNB		TI,$
		CLR		TI
		
		MOV		SBUF,R6
		JNB		TI,$			
		CLR		TI				;Communication End
		
		JNB		RI,$			;Stuck here
		CLR		RI
		MOV		A,SBUF
		XRL		A,#00H
		JNZ		SEND
		RET

DELAYL:	MOV		R5,#30H
NEXT1:	MOV		R6,#30H
NEXT2:	MOV		R7,#40H
		DJNZ	R7,$
		DJNZ	R6,NEXT2
		DJNZ	R5,NEXT1
		RET
			
KEYVALUE:DB	77H,7BH,7DH,7EH,0B7H,0BBH,0BDH,0BEH,0D7H,0DBH,0DDH,0DEH,0E7H,0EBH,0EDH,0EEH
LCDDB:	 DB	44H,69H,61H,6EH,6BH,65H,31H,38H,30H,33H,4AH,67H,5AH,75H,0FAH,0FBH
		END