		ORG		0000H
		RS 		EQU P3.5
		RW		EQU	P3.6
		E		EQU P3.7
		AJMP	START
		ORG		0030H
START:	MOV		P1,#00000001B	;LCD1602 INIT
		ACALL	ENABLE
		MOV		P1,#00111000B
		ACALL	ENABLE
		MOV		P1,#00001111B
		ACALL	ENABLE
		MOV		P1,#00000110B
		ACALL	ENABLE
		
		MOV		DPTR,#TABLE
		MOV		R2,#0FFH
		MOV		R0,#3FH
LOOP1:	INC		R2
		INC		R0
		MOV		A,R2
		MOVC	A,@A+DPTR
		MOV		@R0,A
		
		SETB	E
		MOV		P1,A
		SETB	RS
		CLR		RW
		CLR		E
		ACALL	DELAYL
		
		CJNE	R2,#09H,LOOP1
		
		CLR		RS
		CLR		RW
		
		MOV		P1,#00000110B
		ACALL	ENABLE
		MOV		P1,#0C0H
		ACALL	ENABLE
		
LOOP2:	INC		R2
		INC		R0
		MOV		A,R2
		MOVC	A,@A+DPTR
		MOV		@R0,A
		
		SETB	E
		MOV		P1,A
		SETB	RS
		CLR		RW
		CLR		E
		ACALL	DELAYL
		CLR		E
		
		CJNE	R2,#13H,LOOP2

ASTART:	CLR		EA
		MOV		TMOD,#20H
		MOV		TH1,#0F4H
		MOV		TL1,#0F4H
		MOV		PCON,#00H
		SETB	TR1
		MOV		SCON,#50H

ALOOP1:	MOV		SBUF,#0E1H		;Preparation Start
		JNB		TI,$
		CLR		TI
		
		JNB		RI,$
		CLR		RI
		MOV		A,SBUF
		XRL		A,#0E2H
		JNZ		ALOOP1					;Preparation End
		
		MOV		R0,#40H
		MOV		R7,#14H
		MOV		R6,#00H
		
ALOOP2:	MOV		SBUF,@R0		;Communicaton Start
		MOV		A,R6
		ADD		A,@R0
		MOV		R6,A
		INC		R0
		JNB		TI,$
		CLR		TI
		DJNZ	R7,ALOOP2
		MOV		SBUF,R6
		JNB		TI,$
		CLR		TI				;Communication End
		
		JNB		RI,$
		CLR		RI
		MOV		A,SBUF
		XRL		A,#00H
		JNZ		ALOOP2
		
		SJMP	$

DELAY:	MOV		R3,#40H
D1:		MOV		R4,#40H
D2:		MOV		R5,#44H
		DJNZ	R5,$
		DJNZ	R4,D2
		DJNZ	R3,D1
		RET
ENABLE:	CLR		RS
		CLR		RW
		CLR		E
		ACALL	DELAYL
		SETB	E
		RET
DELAYL:	MOV		P1,#0FFH
		CLR		RS
		SETB	RW
		CLR		E
		NOP
		SETB	E
		JB		P1.7,DELAY
		RET

KEYVALUE:DB	77H,7BH,7DH,7EH,0B7H,0BBH,0BDH,0BEH,0D7H,0DBH,0DDH,0DEH,0E7H,0EBH,0EDH,0EEH
TABLE:	DB	38H,32H,30H,36H,31H,38H,30H,33H,30H,32H,4AH,69H,61H,6EH,67H,5AH,69H,4AH,75H,6EH
		END